## arch/arm/mach-columbus/Kconfig
```kconfig
if ARCH_COLUMBUS

config TARGET_CB_FPGA
	bool "Columbus FPGA board"

config SYS_MALLOC_F
	default y

config SPL_SYS_MALLOC_SIMPLE
	default y

config DM_SERIAL
	default y

source "board/columbus/cb_fpga/Kconfig"

endif
```

## board/columbus/cb_fpga/Kconfig
```kconfig
if TARGET_CB_FPGA

config SYS_BOARD
	default "cb_fpga"

config SYS_VENDOR
	default "columbus"

config SYS_CONFIG_NAME
	default "cb_fpga"

endif
```
